## config/west.yml
```yaml
manifest:
  remotes:
    - name: zmkfirmware
      url-base: https://github.com/zmkfirmware
    # Full LVGL 9 migration fork; remove when upstream merges its migration.
    - name: tokyo2006
      url-base: https://github.com/tokyo2006
    - name: urob
      url-base: https://github.com/urob
  projects:
    - name: zmk
      remote: zmkfirmware
      revision: 6e2ef41e022d555b10f116e395832913f71717b3
      import: app/west.yml
    # support nice_oled and nice_epaper
    - name: zmk-nice-oled
      remote: tokyo2006
      revision: de5b2afbd05f1a136e31ca28659373cd07d1e443
    - name: zmk-helpers
      remote: urob
      revision: 95edb8f15ef1d1bd8332810555f8cf5837fbdd27
  self:
    path: config
```
